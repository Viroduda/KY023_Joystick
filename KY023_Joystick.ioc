# file: KY023_Joystick.ioc
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Mcu.Family=STM32F4
Mcu.Name=STM32F411R(C-E)Tx
Mcu.Package=LQFP64
NVIC.PriorityGroup=NVIC_PRIORITYGROUP_0
ProjectManager.HeapSize=0x200
ProjectManager.StackSize=0x400
ProjectManager.TargetToolchain=STM32CubeIDE
RCC.48MHZClocksFreq_Value=84000000
RCC.AHBFreq_Value=16000000
RCC.APB1Freq_Value=16000000
RCC.APB1TimFreq_Value=16000000
RCC.APB2Freq_Value=16000000
RCC.APB2TimFreq_Value=16000000
RCC.CortexFreq_Value=16000000
RCC.FLatency-AdvancedSettings=FLASH_LATENCY_0
RCC.HCLKFreq_Value=16000000
RCC.HSE_VALUE=8000000
RCC.HSI_VALUE=16000000
RCC.LSE_VALUE=32768
RCC.PLLN=336
RCC.PLLP=RCC_PLLP_DIV4
RCC.SYSCLKFreq_VALUE=16000000
RCC.VCOOutputFreq_Value=336000000
board=NUCLEO-F411RE

// file: Core/Src/main.c
/* USER CODE BEGIN Header */
/**
  ******************************************************************************
  * @file           : main.c
  * @brief          : Main program body
  ******************************************************************************
  * @attention
  *
  * Copyright (c) 2025 STMicroelectronics.
  * All rights reserved.
  *
  * This software is licensed under terms that can be found in the LICENSE file
  * in the root directory of this software component.
  * If no LICENSE file comes with this software, it is provided AS-IS.
  *
  ******************************************************************************
  */
/* USER CODE END Header */
#include "main.h"

/* USER CODE BEGIN Includes */
#include "../utils/inc/utils.h"
/* USER CODE END Includes */

/* USER CODE BEGIN PV */
uint16_t adc_buffer[2];
uint16_t joystick_x = 0;
uint16_t joystick_y = 0;
/* USER CODE END PV */

void SystemClock_Config(void);
/* USER CODE BEGIN PFP */
void GPIO_Init(void);
/* USER CODE END PFP */

int main(void)
{

  /* MCU Configuration--------------------------------------------------------*/

  /* Reset of all peripherals, Initializes the Flash interface and the Systick. */
  HAL_Init();

  /* Configure the system clock */
  SystemClock_Config();

  /* Initialize all configured peripherals */
  /* USER CODE BEGIN 2 */
  GPIO_Init();
  ADC_Scan_Init();
  DMA2_Stream0_Init();
  USART2_Init();
  delay_ms_init();
  /* USER CODE END 2 */

  /* Infinite loop */
  /* USER CODE BEGIN WHILE */
  while (1)
  {
	  joystick_x = adc_buffer[0];
	  printf("Joystick X: %d mV ", joystick_x);
	  if (joystick_x > 3500)
	  {
		  GPIOA->BSRR = (1 << (8 + 16)); // output LOW
		  GPIOA->BSRR = (1 << 6); // output HIGH
	  }
	  else if (joystick_x < 1000)
	  {
		  GPIOA->BSRR = (1 << (6 + 16)); // output LOW
		  GPIOA->BSRR = (1 << 8); // output HIGH
	  }
	  else
	  {
		  GPIOA->BSRR = (1 << (6 + 16)); // output LOW
		  GPIOA->BSRR = (1 << (8 + 16)); // output LOW
	  }
	  joystick_y = adc_buffer[1];
	  printf("Joystick Y: %d mV \r\n", joystick_y);
	  if (joystick_y > 3500)
	  {
		  GPIOA->BSRR = (1 << (5 + 16)); // output LOW
		  GPIOA->BSRR = (1 << 7); // output HIGH
	  }
	  else if (joystick_y < 1000)
	  {
		  GPIOA->BSRR = (1 << (7 + 16)); // output LOW
		  GPIOA->BSRR = (1 << 5); // output HIGH
	  }
	  else
	  {
		  GPIOA->BSRR = (1 << (5 + 16)); // output LOW
		  GPIOA->BSRR = (1 << (7 + 16)); // output LOW
	  }
	  delay_ms(50);
	  /* USER CODE END WHILE */

  }
}

void SystemClock_Config(void)
{
  RCC_OscInitTypeDef RCC_OscInitStruct = {0};
  RCC_ClkInitTypeDef RCC_ClkInitStruct = {0};

  /** Configure the main internal regulator output voltage
  */
  __HAL_RCC_PWR_CLK_ENABLE();
  __HAL_PWR_VOLTAGESCALING_CONFIG(PWR_REGULATOR_VOLTAGE_SCALE1);

  /** Initializes the RCC Oscillators according to the specified parameters
  * in the RCC_OscInitTypeDef structure.
  */
  RCC_OscInitStruct.OscillatorType = RCC_OSCILLATORTYPE_HSI;
  RCC_OscInitStruct.HSIState = RCC_HSI_ON;
  RCC_OscInitStruct.HSICalibrationValue = RCC_HSICALIBRATION_DEFAULT;
  RCC_OscInitStruct.PLL.PLLState = RCC_PLL_NONE;
  if (HAL_RCC_OscConfig(&RCC_OscInitStruct) != HAL_OK)
  {
    Error_Handler();
  }

  /** Initializes the CPU, AHB and APB buses clocks
  */
  RCC_ClkInitStruct.ClockType = RCC_CLOCKTYPE_HCLK|RCC_CLOCKTYPE_SYSCLK
                              |RCC_CLOCKTYPE_PCLK1|RCC_CLOCKTYPE_PCLK2;
  RCC_ClkInitStruct.SYSCLKSource = RCC_SYSCLKSOURCE_HSI;
  RCC_ClkInitStruct.AHBCLKDivider = RCC_SYSCLK_DIV1;
  RCC_ClkInitStruct.APB1CLKDivider = RCC_HCLK_DIV1;
  RCC_ClkInitStruct.APB2CLKDivider = RCC_HCLK_DIV1;

  if (HAL_RCC_ClockConfig(&RCC_ClkInitStruct, FLASH_LATENCY_0) != HAL_OK)
  {
    Error_Handler();
  }
}

/* USER CODE BEGIN 4 */
void GPIO_Init(void)
{
	// Defining pins PA5, PA6, PA7 and PA8 as output with push-pull configuration
	RCC->AHB1ENR |= (1 << 0);	// enabling PORT A clock
	GPIOA->MODER &= ~((3 << 2*5) | (3 << 2*6) | (3 << 2*7) | (3 << 2*8)); // sets to 0 the bits that are going to be written
	GPIOA->MODER |= ((1 << 2*5) | (1 << 2*6)| (1 << 2*7)| (1 << 2*8)); // pin PA5 defined as output
	GPIOA->OTYPER &= ~((1 << 2*5) | (1 << 2*6)| (1 << 2*7)| (1 << 2*8)); // output with push-pull configuration
	GPIOA->OSPEEDR &= ~((3 << 2*5) | (3 << 2*6) | (3 << 2*7) | (3 << 2*8)); // pin speed definition (inverse)
	GPIOA->PUPDR &= ~((3 << 2*5) | (3 << 2*6) | (3 << 2*7) | (3 << 2*8));

	// Defining pins PA0 and PA1 as analog input without internal pull-up/down resistors, as the joystick already have them
	GPIOA->MODER |= ((3 << (0 * 2)) | (3 << (1 * 2))); // pin PA0 defined as analog input
	GPIOA->PUPDR &= ~(3 << (0 * 2) | (3 << (1 * 2))); // no pull-up/pull-down resistor for PA0
}
/* USER CODE END 4 */

void Error_Handler(void)
{
  __disable_irq();
  while (1)
  {
  }
}
